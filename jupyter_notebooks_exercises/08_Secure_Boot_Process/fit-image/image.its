## jupyter_notebooks_exercises/08_Secure_Boot_Process/fit-image/image.its
```
/*
 * Compilation:
 * mkimage -f fit_kernel_dtb.its fit_kernel_dtb.itb
 *
 * Files in linux build dir:
 * - arch/arm/boot/zImage
 * - arch/arm/boot/dts/stm32mp157c-dk2.dtb
 * - arch/arm/boot/dts/stm32mp157c-ev1.dtb
 *
 * load mmc 0:4 $kernel_addr_r fit_kernel_dtb.itb
 * bootm $kernel_addr_r
 * bootm $kernel_addr_r#dk2
 * bootm $kernel_addr_r#ev1
 *
 * or use extlinux.conf in this directory
 */

/dts-v1/;
/ {
	description = "U-Boot fitImage for stm32mp157";
	#address-cells = <1>;

	images {
		kernel {
			description = "Linux kernel";
			data = /incbin/("zImage");
			type = "kernel";
			arch = "arm";
			os = "linux";
			compression = "none";
			load = <0xC0008000>;
			entry = <0xC0008000>;
			hash-1 {
				algo = "sha256";
			};
		};

		fdt-dk2 {
			description = "FDT dk2";
			data = /incbin/("stm32mp157c-dk2.dtb");
			type = "flat_dt";
			arch = "arm";
			compression = "none";
			hash-1 {
				algo = "sha256";
			};
		};

	};

	configurations {
		default = "dk2";

		dk2 {
			description = "dk2";
			kernel = "kernel";
			fdt = "fdt-dk2";
		    signature-1 {
				algo = "sha256,rsa2048";
				key-name-hint = "dev";
				sign-images = "fdt", "kernel";
			};
        };
	};
};
```
